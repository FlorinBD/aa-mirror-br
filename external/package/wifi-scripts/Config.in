## external/package/wifi-scripts/Config.in
```kconfig
config BR2_PACKAGE_WIFI_SCRIPTS
    bool "wifi init/stop scripts"
    help
      Installs wifi-init.sh and wifi-stop.sh to /usr/bin with executable permissions
```
