## external/Config.in
```kconfig
source "$BR2_EXTERNAL_AA_MIRROR_OS_PATH/package/Config.in"
source "$BR2_EXTERNAL_AA_MIRROR_OS_PATH/boot/Config.in"
```

## external/boot/Config.in
```kconfig
menu "Bootloaders"
    source "$BR2_EXTERNAL_AA_MIRROR_OS_PATH/boot/uboot/Config.in"
endmenu
```
